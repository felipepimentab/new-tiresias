## boards/eesc-usp/tiresias_dk/board.yml
```yaml
board:
  name: tiresias_dk
  full_name: Tiresias DK
  vendor: eesc-usp
  socs:
  - name: 'nrf5340'
    variants:
    - name: 'ns'
      cpucluster: 'cpuapp'
```
